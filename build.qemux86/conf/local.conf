## build.qemux86/conf/local.conf
```bitbake
#
# This file is your local configuration file and is where all local user settings
# are placed. The comments in this file give some guide to the options a new user
# to the system might want to change but pretty much any configuration option can
# be set in this file. More adventurous users can look at local.conf.extended
# which contains other examples of configuration which can be placed in this file
# but new users likely won't need any of them initially.
#
# Lines starting with the '#' character are commented out and in some cases the
# default values are provided as comments to show people example syntax. Enabling
# the option is a question of removing the # character and making any change to the
# variable as required.

BUILDIR = "${TOPDIR}"
U2UPDIR = "${@os.path.abspath("${BUILDIR}/..")}"
YOCTODIR = "${@os.path.abspath("${U2UPDIR}/..")}"

require ${U2UPDIR}/conf/local.conf

#
# Machine Selection
#
# You need to select a specific machine to target the build with. There are a selection
# of emulated machines available which can boot and run in the QEMU emulator:
#
#MACHINE ?= "qemuarm"
#MACHINE ?= "qemuarm64"
#MACHINE ?= "qemumips"
#MACHINE ?= "qemumips64"
#MACHINE ?= "qemuppc"
#MACHINE ?= "qemux86"
#MACHINE ?= "qemux86-64"
#
# There are also the following hardware board target machines included for 
# demonstration purposes:
#
#MACHINE ?= "beaglebone-yocto"
#MACHINE ?= "genericx86"
#MACHINE ?= "genericx86-64"
#MACHINE ?= "mpc8315e-rdb"
#MACHINE ?= "edgerouter"
#
# This sets the default machine to be qemux86 if no other machine is selected:
MACHINE ??= "qemux86"
```

## meta-u2up/conf/layer.conf
```bitbake
# We have a conf and classes directory, add to BBPATH
BBPATH .= ":${LAYERDIR}"

# We have recipes-* directories, add to BBFILES
BBFILES += "${LAYERDIR}/recipes-*/*/*.bb \
            ${LAYERDIR}/recipes-*/*/*.bbappend"

BBFILE_COLLECTIONS += "meta-u2up"
BBFILE_PATTERN_meta-u2up = "^${LAYERDIR}/"
BBFILE_PRIORITY_meta-u2up = "6"
```

## u2up/build.raspberrypi3-64/conf/bblayers.conf
```bitbake
BBPATH = "${TOPDIR}"

BUILDIR = "${TOPDIR}"
U2UPDIR = "${@os.path.abspath("${BUILDIR}/..")}"
YOCTODIR = "${@os.path.abspath("${U2UPDIR}/..")}"

require ${U2UPDIR}/conf/bblayers.conf

BBLAYERS += " \
  ${YOCTODIR}/meta-raspberrypi_${YOCTO_BRANCH} \
  "
```

## u2up/conf/bblayers.conf
```bitbake
# POKY_BBLAYERS_CONF_VERSION is increased each time build/conf/bblayers.conf
# changes incompatibly
POKY_BBLAYERS_CONF_VERSION = "2"

BBFILES ?= ""

BBLAYERS ?= " \
  ${U2UPDIR}/meta-u2up \
  ${YOCTODIR}/${U2UP_REPOS_DIR}/poky_${U2UP_POKY_BRANCH}/meta \
  ${YOCTODIR}/${U2UP_REPOS_DIR}/poky_${U2UP_POKY_BRANCH}/meta-poky \
  ${YOCTODIR}/${U2UP_REPOS_DIR}/poky_${U2UP_POKY_BRANCH}/meta-yocto-bsp \
  "
```

## u2up_thud/conf/bblayers.conf
```bitbake
# POKY_BBLAYERS_CONF_VERSION is increased each time build/conf/bblayers.conf
# changes incompatibly
POKY_BBLAYERS_CONF_VERSION = "2"

BBFILES ?= ""

BBLAYERS ?= " \
  ${U2UPDIR}/meta-u2up \
  ${YOCTODIR}/poky_${YOCTO_BRANCH}/meta \
  ${YOCTODIR}/poky_${YOCTO_BRANCH}/meta-poky \
  ${YOCTODIR}/poky_${YOCTO_BRANCH}/meta-yocto-bsp \
  "
```

## u2up_thud/meta-u2up/conf/distro/u2up.conf
```bitbake
# Distro Layer configuration
# include and overwrite default poky distro
include conf/distro/poky.conf
DISTRO = "u2up"
DISTRO_NAME = "U2UP (Poky based Linux Distro)"
DISTRO_VERSION = "2.6"
DISTRO_CODENAME = "thud"
SDK_VENDOR = "-u2upsdk"
SDK_VERSION := "${@'${DISTRO_VERSION}'.replace('snapshot-${DATE}','snapshot')}"

MAINTAINER = "Samo Pogačnik <samo_pogacnik@t-2.net>"

TARGET_VENDOR = "-u2up"

LOCALCONF_VERSION = "1"

DISTRO_VERSION[vardepsexclude] = "DATE"
SDK_VERSION[vardepsexclude] = "DATE"

# Override these in poky based distros
U2UP_DEFAULT_DISTRO_FEATURES = "bluetooth ext2 largefile ptest multiarch usbgadget usbhost wifi xattr nfs zeroconf 3g"
U2UP_DEFAULT_EXTRA_RDEPENDS = "packagegroup-core-boot"
U2UP_DEFAULT_EXTRA_RRECOMMENDS = "kernel-module-af-packet"

DISTRO_EXTRA_RDEPENDS += " ${U2UP_DEFAULT_EXTRA_RDEPENDS}"
DISTRO_EXTRA_RRECOMMENDS += " ${U2UP_DEFAULT_EXTRA_RRECOMMENDS}"

DISTRO_FEATURES ?= "${U2UP_DEFAULT_DISTRO_FEATURES} ${DISTRO_FEATURES_LIBC} "

PACKAGE_CLASSES = "package_ipk"

# Use systemd as init manager
DISTRO_FEATURES_append = " systemd"
DISTRO_FEATURES_BACKFILL_CONSIDERED += "sysvinit"
VIRTUAL-RUNTIME_init_manager = "systemd"
VIRTUAL-RUNTIME_initscripts = "systemd-compat-units"

PREFERRED_VERSION_linux-yocto ?= "4.14%"

SDK_NAME = "${DISTRO}-${TCLIBC}-${SDK_ARCH}-${IMAGE_BASENAME}-${TUNE_PKGARCH}"
SDKPATH = "/opt/${DISTRO}/${SDK_VERSION}"

U2UPQEMUDEPS = "${@bb.utils.contains("INCOMPATIBLE_LICENSE", "GPL-3.0", "", "packagegroup-core-device-devel",d)}"
DISTRO_EXTRA_RDEPENDS_append_qemuarm = " ${U2UPQEMUDEPS}"
DISTRO_EXTRA_RDEPENDS_append_qemuarm64 = " ${U2UPQEMUDEPS}"
DISTRO_EXTRA_RDEPENDS_append_qemumips = " ${U2UPQEMUDEPS}"
DISTRO_EXTRA_RDEPENDS_append_qemuppc = " ${U2UPQEMUDEPS}"
DISTRO_EXTRA_RDEPENDS_append_qemux86 = " ${U2UPQEMUDEPS}"
DISTRO_EXTRA_RDEPENDS_append_qemux86-64 = " ${U2UPQEMUDEPS}"

SANITY_TESTED_DISTROS += " \
            ubuntu-18.04 \n \
            "
```
